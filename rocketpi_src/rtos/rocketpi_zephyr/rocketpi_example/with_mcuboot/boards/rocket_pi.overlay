/*
 * Copyright (c) 2025 STMicroelectronics
 *
 * SPDX-License-Identifier: Apache-2.0
 */
/ {
	chosen {
		zephyr,flash = &flash0;
		zephyr,flash-controller = &flash0;
		zephyr,code-partition = &slot0_partition;
	};
};
