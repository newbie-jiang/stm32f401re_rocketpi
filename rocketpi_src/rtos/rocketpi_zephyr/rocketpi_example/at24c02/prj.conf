## CMakeLists.txt
```
# SPDX-License-Identifier: Apache-2.0

cmake_minimum_required(VERSION 3.20.0)
find_package(Zephyr REQUIRED HINTS $ENV{ZEPHYR_BASE})
project(at24c02_sample)

target_sources(app PRIVATE
  src/main.c
  at24xx/driver_at24cxx.c
  at24xx/driver_at24cxx_basic.c
  at24xx/driver_at24cxx_read_test.c
  at24xx/driver_at24cxx_interface.c
  soft_i2c/soft_i2c.c
)

target_include_directories(app PRIVATE
  at24xx
  soft_i2c
)
```

## prj.conf
```kconfig
CONFIG_LOG=y
CONFIG_HEAP_MEM_POOL_SIZE=2048
CONFIG_MAIN_STACK_SIZE=2048
CONFIG_GPIO=y
CONFIG_I2C=y
# console
CONFIG_CONSOLE=y
CONFIG_UART_CONSOLE=y

CONFIG_SENSOR=y
```

## boards/rocket_pi.overlay
```dts
#include <zephyr/dt-bindings/gpio/gpio.h>

/ {
	aliases {
	};

	at24_soft_i2c:at24_soft_i2c {
		compatible = "zephyr,i2c-bitbang";
		status = "okay";
		scl-gpios = <&gpioc 14 GPIO_ACTIVE_HIGH>;
		sda-gpios = <&gpioc 15 GPIO_ACTIVE_HIGH>;
	};
};
```

## src/main.c
```c
#include <zephyr/kernel.h>
#include <zephyr/logging/log.h>

#include "driver_at24cxx_read_test.h"

LOG_MODULE_REGISTER(at24cxx_sample, CONFIG_LOG_DEFAULT_LEVEL);

int main(void)
{
	int ret = at24cxx_read_test(AT24C02, AT24CXX_ADDRESS_A000);

	if (ret != 0) {
		LOG_ERR("AT24C02 read_test failed (%d)", ret);
	} else {
		LOG_INF("AT24C02 read_test passed");
	}

	while (1) {
		k_sleep(K_SECONDS(5));
	}
}
```
