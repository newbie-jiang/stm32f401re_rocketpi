## CMakeLists.txt
```
cmake_minimum_required(VERSION 3.20.0)
find_package(Zephyr REQUIRED HINTS $ENV{ZEPHYR_BASE})
project(irda_nec_sample)

target_include_directories(app PRIVATE nec_protocol/lib)

target_sources(app PRIVATE
  nec_protocol/lib/nec_prot.c
  src/ir_recv.c
  src/main.c
)
```

## Kconfig
```
# SPDX-License-Identifier: Apache-2.0

menu "Zephyr"
source "Kconfig.zephyr"
endmenu

menu "Application Configuration"

config IR_BUF_SIZE
	int "Size of the IR samples buffer [samples]"
	default 256

config PRINT_RECV_CMDS
	bool "Print details (timing) of received commands"
	default y

config ADJUST_RECEIVE_PULSE
	int "Adjustment of received pulse duration [usec]"
	range -100 100
	default 0

config ADJUST_RECEIVE_SPACE
	int "Adjustment of received space duration [usec]"
	range -100 100
	default 0

endmenu

module = APP
module-str = app
source "subsys/logging/Kconfig.template.log_config"
```

## sample.yaml
```
sample:
  name: IR NEC send/receive shell
tests:
  sample.irda.nec:
    tags:
      - ir
      - shell
    depends_on:
      - gpio
      - pwm
    harness: manual
    platform_allow:
      - rocket_pi
      - nucleo_f401re
```

## prj.conf
```kconfig
CONFIG_MAIN_STACK_SIZE=4096

CONFIG_LOG=y

CONFIG_GPIO=y

CONFIG_SERIAL=y
CONFIG_UART_LINE_CTRL=y

CONFIG_USB_DEVICE_STACK=y
CONFIG_USB_DEVICE_PRODUCT="Zephyr IR Tool"

CONFIG_SHELL=y
CONFIG_SHELL_LOG_BACKEND=y
CONFIG_SHELL_BACKEND_SERIAL_CHECK_DTR=y
CONFIG_SHELL_BACKEND_SERIAL_INIT_PRIORITY=51
```

## boards/rocket_pi.overlay
```dts
/ {
	aliases {
		ir-sen = &ir_sensor0;
	};

	ir_sensor {
		compatible = "gpio-keys";

		ir_sensor0: ir_sensor0 {
			label = "IR0";
			gpios = <&gpioa 15 (GPIO_ACTIVE_LOW | GPIO_PULL_UP)>;
		};
	};
};
```

## src/main.c
```c
/*
 * SPDX-License-Identifier: Apache-2.0
 */

#include <zephyr/device.h>
#include <zephyr/drivers/uart.h>
#include <zephyr/kernel.h>
#include <zephyr/logging/log.h>
#include <zephyr/shell/shell.h>
#include <zephyr/usb/usb_device.h>

#include <stdbool.h>
#include <stdlib.h>

#include "ir_recv.h"
#include "ir_types.h"

LOG_MODULE_REGISTER(app, CONFIG_APP_LOG_LEVEL);

K_THREAD_STACK_DEFINE(ir_recv_thread_stack_area, IR_RECV_STACKSIZE);
static struct k_thread ir_recv_thread_data;

static uint32_t samples_buf[CONFIG_IR_BUF_SIZE];
static ir_raw_bit_buf_t ir_buf = {
	.buf = samples_buf,
	.length = 0,
};

static int cmd_set_timeout(const struct shell *shell, size_t argc,
			   char *argv[])
{
	long val = strtol(argv[1], NULL, 10);

	if (val < 0) {
		shell_fprintf(shell, SHELL_ERROR,
			      "Invalid value (negative): %s\n", argv[1]);
		return -EINVAL;
	}

	ir_recv_set_timeout((uint32_t)val);
	shell_fprintf(shell, SHELL_NORMAL,
		      "IR receive timeout set to: %d ms\n",
		      ir_recv_get_timeout());

	return 0;
}

static int cmd_get_timeout(const struct shell *shell, size_t argc,
			   char *argv[])
{
	ARG_UNUSED(argc);
	ARG_UNUSED(argv);

	shell_fprintf(shell, SHELL_NORMAL, "IR receive timeout: %d ms\n",
		      ir_recv_get_timeout());
	return 0;
}

static int cmd_recv_enable(const struct shell *shell, size_t argc,
			   char *argv[])
{
	ARG_UNUSED(argc);
	ARG_UNUSED(argv);

	ir_recv_enable();
	shell_fprintf(shell, SHELL_NORMAL, "IR receiving enabled\n");
	return 0;
}

static int cmd_recv_disable(const struct shell *shell, size_t argc,
			    char *argv[])
{
	ARG_UNUSED(argc);
	ARG_UNUSED(argv);

	ir_recv_disable();
	shell_fprintf(shell, SHELL_NORMAL, "IR receiving disabled\n");
	return 0;
}

static int cmd_adj_get(const struct shell *shell, size_t argc, char *argv[])
{
	ARG_UNUSED(argc);
	ARG_UNUSED(argv);

	ir_tim_adj_t recv_tim = ir_recv_get_tim_adj();

	shell_fprintf(shell, SHELL_NORMAL, "IR timing adjustment (receive only):\n");
	shell_fprintf(shell, SHELL_NORMAL, "  -Pulse: %d usec\n", recv_tim.pulse);
	shell_fprintf(shell, SHELL_NORMAL, "  -Space: %d usec\n", recv_tim.space);

	return 0;
}

static int cmd_adj_recv(const struct shell *shell, size_t argc, char *argv[])
{
	ARG_UNUSED(argc);

	ir_tim_adj_t recv_tim = {
		.pulse = strtol(argv[1], NULL, 0),
		.space = strtol(argv[2], NULL, 0),
	};

	ir_recv_set_tim_adj(recv_tim);

	shell_fprintf(shell, SHELL_NORMAL, "IR timing recv adjustment:\n");
	shell_fprintf(shell, SHELL_NORMAL, "    -Pulse: %d usec\n",
		      recv_tim.pulse);
	shell_fprintf(shell, SHELL_NORMAL, "    -Space: %d usec\n",
		      recv_tim.space);

	return 0;
}

SHELL_STATIC_SUBCMD_SET_CREATE(
	ir_adj_cmds,
	SHELL_CMD_ARG(list, NULL, "list IR timing adjustment\n", cmd_adj_get, 1,
		      0),
	SHELL_CMD_ARG(recv, NULL,
		      "adjust receive IR timing\nargs: <pulse> <space>\n",
		      cmd_adj_recv, 3, 0),
	SHELL_SUBCMD_SET_END);

SHELL_CMD_REGISTER(ir_adj, &ir_adj_cmds, "IR timing adjustment", NULL);

SHELL_STATIC_SUBCMD_SET_CREATE(
	ir_recv_cmds,
	SHELL_CMD_ARG(enable, NULL, "enable receiving\n", cmd_recv_enable, 1,
		      0),
	SHELL_CMD_ARG(disable, NULL, "disable receiving\n", cmd_recv_disable,
		      1, 0),
	SHELL_CMD_ARG(set_timeout, NULL,
		      "set timeout\nargs: <miliseconds>\n", cmd_set_timeout, 2,
		      0),
	SHELL_CMD_ARG(get_timeout, NULL, "get timeout\n", cmd_get_timeout, 1, 0),
	SHELL_SUBCMD_SET_END);

SHELL_CMD_REGISTER(ir_recv, &ir_recv_cmds, "Receive IR command", NULL);

void main(void)
{
#if DT_NODE_HAS_COMPAT(DT_CHOSEN(zephyr_shell_uart), zephyr_cdc_acm_uart)
	const struct device *dev = DEVICE_DT_GET(DT_CHOSEN(zephyr_shell_uart));
	uint32_t dtr = 0U;

	if (!device_is_ready(dev) || usb_enable(NULL)) {
		return;
	}

	while (!dtr) {
		uart_line_ctrl_get(dev, UART_LINE_CTRL_DTR, &dtr);
		k_sleep(K_MSEC(100));
	}
#endif

	ir_recv_set_buf(&ir_buf);

	k_thread_create(&ir_recv_thread_data, ir_recv_thread_stack_area,
			K_THREAD_STACK_SIZEOF(ir_recv_thread_stack_area),
			ir_recv_thread_entry, NULL, NULL, NULL, IR_RECV_PRIORITY,
			0, K_FOREVER);
	k_thread_name_set(&ir_recv_thread_data, "ir_recv_thread");
	k_thread_start(&ir_recv_thread_data);
}
```

## src/ir_recv.c
```c
/*
 * Copyright (c) 2022 Jan Privara
 * SPDX-License-Identifier: Apache-2.0
 */

#include "ir_recv.h"

#include <zephyr/device.h>
#include <zephyr/drivers/gpio.h>
#include <zephyr/kernel.h>
#include <zephyr/logging/log.h>

#include "nec_prot.h"

#define IR_SEN_NODE DT_ALIAS(ir_sen)
#if !DT_NODE_HAS_STATUS(IR_SEN_NODE, okay)
#error "Unsupported board: ir-sen devicetree alias is not defined"
#endif

LOG_MODULE_DECLARE(app, CONFIG_APP_LOG_LEVEL);

static const struct gpio_dt_spec irsen = GPIO_DT_SPEC_GET(IR_SEN_NODE, gpios);
static struct gpio_callback irsen_cb_data;

static uint32_t recv_timeout_ms = 10;

static ir_raw_bit_buf_t *ir_recv_buf;

static int recv_enabled;
static int recv_started;

static int prev_val;
static uint32_t prev_time;

typedef enum {
	ST_DISABLED = 0,
	ST_ENABLED,
	ST_RECEIVING,
	ST_FINISHED,
} state_t;

static state_t current_state = ST_DISABLED;

static ir_tim_adj_t recv_tim_adj = {
	.pulse = CONFIG_ADJUST_RECEIVE_PULSE,
	.space = CONFIG_ADJUST_RECEIVE_SPACE,
};

static void finished(void)
{
	recv_enabled = 0;
	current_state = ST_FINISHED;
}

static void timeout_handler(struct k_timer *timer_id)
{
	ARG_UNUSED(timer_id);

	uint32_t time = k_cycle_get_32();
	const uint32_t us_div = sys_clock_hw_cycles_per_sec() / 1000000U;

	if (ir_recv_buf->length < CONFIG_IR_BUF_SIZE - 1) {
		ir_recv_buf->buf[ir_recv_buf->length++] =
			(time - prev_time) / us_div;
	}

	finished();
}

K_TIMER_DEFINE(tout_timer, timeout_handler, NULL);

static void irsen_change(const struct device *dev, struct gpio_callback *cb,
			 uint32_t pins)
{
	ARG_UNUSED(dev);
	ARG_UNUSED(cb);
	ARG_UNUSED(pins);

	if (!recv_enabled) {
		return;
	}

	uint32_t time = k_cycle_get_32();
	int val = gpio_pin_get_dt(&irsen);

	if ((val != 0) && (val != 1)) {
		LOG_ERR("GPIO read error");
		return;
	}

	const uint32_t us_div = sys_clock_hw_cycles_per_sec() / 1000000U;

	if (!recv_started) {
		if (val == 1) {
			prev_val = val;
			prev_time = time;
			recv_started = 1;
			ir_recv_buf->length = 0;
			current_state = ST_RECEIVING;
			k_timer_start(&tout_timer, K_MSEC(recv_timeout_ms),
				      K_NO_WAIT);
		}
		return;
	}

	k_timer_start(&tout_timer, K_MSEC(recv_timeout_ms), K_NO_WAIT);

	if (val == prev_val) {
		LOG_WRN("Missed a transition of IR sensor");
		return;
	}

	if (ir_recv_buf->length < CONFIG_IR_BUF_SIZE - 1) {
		uint32_t duration = (time - prev_time) / us_div;

		duration += prev_val == 1 ? recv_tim_adj.pulse :
					    recv_tim_adj.space;

		ir_recv_buf->buf[ir_recv_buf->length++] = duration;
		prev_time = time;
		prev_val = val;
	}

	if (ir_recv_buf->length == CONFIG_IR_BUF_SIZE) {
		k_timer_stop(&tout_timer);
		finished();
	}
}

static void init(void)
{
	if (!device_is_ready(irsen.port)) {
		LOG_ERR("irsen device %s is not ready", irsen.port->name);
		return;
	}

	int ret = gpio_pin_configure_dt(&irsen, GPIO_INPUT);
	if (ret != 0) {
		LOG_ERR("Failed to configure %s pin %d (%d)", irsen.port->name,
			irsen.pin, ret);
		return;
	}

	ret = gpio_pin_interrupt_configure_dt(&irsen, GPIO_INT_EDGE_BOTH);
	if (ret != 0) {
		LOG_ERR("Failed to configure interrupt on %s pin %d (%d)",
			irsen.port->name, irsen.pin, ret);
		return;
	}

	gpio_init_callback(&irsen_cb_data, irsen_change, BIT(irsen.pin));
	gpio_add_callback(irsen.port, &irsen_cb_data);
}

ir_tim_adj_t ir_recv_get_tim_adj(void)
{
	return recv_tim_adj;
}

void ir_recv_set_tim_adj(ir_tim_adj_t tim)
{
	recv_tim_adj = tim;
}

void ir_recv_enable(void)
{
	if ((current_state != ST_DISABLED) && (current_state != ST_FINISHED)) {
		return;
	}

	recv_started = 0;
	recv_enabled = 1;
	current_state = ST_ENABLED;
}

void ir_recv_disable(void)
{
	recv_enabled = 0;
	k_timer_stop(&tout_timer);
	current_state = ST_DISABLED;
}

bool ir_recv_is_enabled(void)
{
	return current_state != ST_DISABLED;
}

void ir_recv_set_timeout(uint32_t timeout_ms)
{
	recv_timeout_ms = timeout_ms;
}

uint32_t ir_recv_get_timeout(void)
{
	return recv_timeout_ms;
}

void ir_recv_set_buf(ir_raw_bit_buf_t *buf)
{
	ir_recv_buf = buf;
}

static void decode_ir_buf(void)
{
	nec_waveform_t nec_wave = {
		.length = ir_recv_buf->length,
		.samples = ir_recv_buf->buf,
	};

	nec_decoded_data_t nec_result;

	int samples_used = nec_decode(&nec_wave, &nec_result);

	if (samples_used > 0) {
		LOG_INF("NEC address: 0x%04x", nec_result.address);
		LOG_INF("NEC command: 0x%04x", nec_result.command);
	} else {
		LOG_INF("NEC decoding failed");
	}
}

void ir_recv_thread_entry(void *p1, void *p2, void *p3)
{
	ARG_UNUSED(p1);
	ARG_UNUSED(p2);
	ARG_UNUSED(p3);

	init();

	ir_recv_enable();

	while (1) {
		if (current_state == ST_FINISHED) {
			LOG_INF("Receiving finished, %d samples",
				ir_recv_buf->length);

#ifdef CONFIG_PRINT_RECV_CMDS
			for (int i = 0; i < ir_recv_buf->length; i += 2) {
				if (i + 1 < ir_recv_buf->length) {
					LOG_INF("%03d: %d - %d", i,
						ir_recv_buf->buf[i],
						ir_recv_buf->buf[i + 1]);
				} else {
					LOG_INF("%03d: %d", i,
						ir_recv_buf->buf[i]);
				}
				k_msleep(10);
			}
#endif

			decode_ir_buf();

			ir_recv_enable();
		}

		k_msleep(1);
	}
}
```

## src/ir_recv.h
```c
/*
 * Copyright (c) 2022 Jan Privara
 * SPDX-License-Identifier: Apache-2.0
 */

#ifndef IR_RECV_H
#define IR_RECV_H

#include <inttypes.h>
#include <stdbool.h>

#include "ir_types.h"

#define IR_RECV_STACKSIZE 1024
#define IR_RECV_PRIORITY 7

ir_tim_adj_t ir_recv_get_tim_adj(void);
void ir_recv_set_tim_adj(ir_tim_adj_t tim);

void ir_recv_enable(void);
void ir_recv_disable(void);
bool ir_recv_is_enabled(void);

void ir_recv_set_timeout(uint32_t timeout_ms);
uint32_t ir_recv_get_timeout(void);

void ir_recv_set_buf(ir_raw_bit_buf_t *buf);

void ir_recv_thread_entry(void *, void *, void *);

#endif /* IR_RECV_H */
```

## src/ir_types.h
```c
/*
 * Copyright (c) 2022 Jan Privara
 * SPDX-License-Identifier: Apache-2.0
 */

#ifndef IR_TYPES_H
#define IR_TYPES_H

#include <inttypes.h>

typedef struct {
	int length;
	uint32_t *buf;
} ir_raw_bit_buf_t;

typedef struct {
	int32_t pulse;
	int32_t space;
} ir_tim_adj_t;

#endif /* IR_TYPES_H */
```
