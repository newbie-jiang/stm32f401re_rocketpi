## CMakeLists.txt
```
# SPDX-License-Identifier: Apache-2.0

cmake_minimum_required(VERSION 3.20.0)
find_package(Zephyr REQUIRED HINTS $ENV{ZEPHYR_BASE})

project(radar_sample)

target_sources(app PRIVATE
    src/main.c
    mg58f18_radar/driver_mg58f18_radar.c
    mg58f18_radar/driver_mg58f18_radar_interface.c
    mg58f18_radar/driver_mg58f18_radar_test.c
)

target_include_directories(app PRIVATE mg58f18_radar)
```

## prj.conf
```kconfig
CONFIG_LOG=y
CONFIG_PRINTK=y

# Radar协议一次性调用/打印较多，给主线程多一些栈
CONFIG_MAIN_STACK_SIZE=4096

CONFIG_SERIAL=y
CONFIG_UART_CONSOLE=y
CONFIG_UART_INTERRUPT_DRIVEN=y
CONFIG_UART_ASYNC_API=y
CONFIG_STDOUT_CONSOLE=y
CONFIG_GPIO=y
CONFIG_DMA=y

CONFIG_SERIAL=y

# console
CONFIG_CONSOLE=y
```

## boards/rocket_pi.overlay
```dts
/*
 * Rocket Pi + MG58F18 radar: enable USART1 (PA9/PA10) and provide an
 * example radar_out GPIO.
 */

/ {
	aliases {
		radaruart = &usart1;
	};

	zephyr,user {
		radar_out_gpios = <&gpioa 6 GPIO_ACTIVE_HIGH>;
	};
};

&usart1 {
	pinctrl-0 = <&usart1_tx_pa9 &usart1_rx_pa10>;
	pinctrl-names = "default";
	status = "okay";
	current-speed = <9600>;
	label = "radar_uart";
};
```

## src/main.c
```c
#include <zephyr/kernel.h>
#include <zephyr/sys/printk.h>

#include "driver_mg58f18_radar_test.h"

int main(void)
{
	printk("MG58F18 radar sample start\n");

	mg58f18_radar_test_run();

	while (1) {
		mg58f18_radar_test_poll();
		k_msleep(20);
	}

	return 0;
}
```
