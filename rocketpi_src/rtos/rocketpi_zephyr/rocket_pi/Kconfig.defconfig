## rocketpi_src/rtos/rocketpi_zephyr/rocket_pi/Kconfig.defconfig
```kconfig
# NUCLEO-64 F401RE board configuration

# Copyright (c) 2016 Linaro Limited.
# Copyright (c) 2019 Centaur Analytics, Inc
# SPDX-License-Identifier: Apache-2.0

if BOARD_ROCKET_PI

config SPI_STM32_INTERRUPT
	default y
	depends on SPI

endif # BOARD_ROCKET_PI
```

## rocketpi_src/rtos/rocketpi_zephyr/rocket_pi/Kconfig.rocket_pi
```kconfig
# Copyright (c) 2016 Linaro Limited.
# SPDX-License-Identifier: Apache-2.0

config BOARD_ROCKET_PI
	select SOC_STM32F401XE
```

## rocketpi_src/rtos/rocketpi_zephyr/rocket_pi/board.yml
```yaml
board:
  name: rocket_pi
  full_name: rocketpi f401re
  vendor: st
  socs:
    - name: stm32f401xe
```

## rocketpi_src/rtos/rocketpi_zephyr/rocketpi_example/buzzer/sample.yaml
```yaml
sample:
  name: AHT30 humidity/temperature sample
tests:
  sample.sensor.aht30:
    tags:
      - sensors
      - drivers
      - i2c
    depends_on:
      - i2c
      - sensor
    harness: console
    harness_config:
      type: one_line
      regex:
        - "AHT30 sample"
    platform_allow:
      - nucleo_f401re
    integration_platforms:
      - nucleo_f401re
```
